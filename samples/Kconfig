## samples/Kconfig
```kconfig
# SPDX-License-Identifier: GPL-2.0-only
menuconfig SAMPLES
	bool "Sample kernel code"
	help
	  You can build and test sample kernel code here.


if SAMPLES


source "samples/rust/Kconfig"

endif # SAMPLES
```

## samples/rust/Kconfig
```kconfig
# SPDX-License-Identifier: GPL-2.0

menuconfig SAMPLES_RUST
	bool "Rust samples"
	depends on RUST
	help
	  You can build sample Rust kernel code here.

	  If unsure, say N.

if SAMPLES_RUST

config SAMPLE_RUST_HELLO
	tristate "Hello"
	help
	  This option builds the Rust Hello module.

	  If unsure, say N.


endif # SAMPLES_RUST
```
